/*Códigos de error:
200 --> Ok
401 --> Error al iniciar termómetro
402 --> Error al leer la temperatura
501 --> Error al iniciar la pantalla LCD
*/

/*Librerías*/
//Pantalla
#include <U8g2lib.h>
#include <SPI.h>


//Termómetro
#include <Wire.h>
#include <Adafruit_MLX90614.h>


//U8G2LIB_ST7920_128X64 u8g2(10, 11, 13, U8G_PIN_NONE);
U8G2_ST7920_128X64_F_SW_SPI u8g2(U8G2_R2, /* clock=*/ 10, /* data=*/ 11, /* CS=*/ 13, /* reset=*/ U8X8_PIN_NONE); // Feather HUZZAH ESP8266, E=clock=14, RW=data=13, RS=CS
Adafruit_MLX90614 termometroIR = Adafruit_MLX90614();


/*Array para almacenar los códigos de estatus:
[0] --> Termómetro
[1] --> Pantalla LCD*/
int estatus [2]; //Espacio para 2 códigos de estatus.
int intento = 0; //Contador interno de void setup()


// Logotipo de la escudería
#define BORREGOS_SF_RACING_TEAM_W 43
#define BORREGOS_SF_RACING_TEAM_H 64
static const unsigned char BORREGOS_SF_RACING_TEAM[] U8X8_PROGMEM = {
   0xe0, 0xf3, 0xff, 0xff, 0x3f, 0x00, 0xf8, 0xf3, 0xff, 0xff, 0xff, 0x00,
   0xfc, 0xf3, 0xff, 0xff, 0xff, 0x01, 0xfe, 0xf1, 0xff, 0xff, 0xff, 0x03,
   0xfe, 0xe1, 0xff, 0xff, 0xff, 0x07, 0xff, 0xc2, 0xff, 0xff, 0xff, 0x07,
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   0xf8, 0xff, 0xff, 0x7f, 0xfe, 0x00, 0xe0, 0xff, 0xff, 0x7f, 0x3e, 0x00 };

  const char DEGREE_SYMBOL[] = { 0xB0, '\0' };


void setup()
{
  Serial.begin(9600);
  /*BOOTUP TERMOMETRO IR*/
  //Sí el código de estatus del termómetro es 200, se ejecuta el código correspondiente.
  while (intento < 3) {
    if (termometroIR.begin() == 1){
      estatus[0] = 200;
      error_handling("Termometro", 200); //Imprime código de estatus
      intento = 3;
    }
    else{
      estatus[0] = 401;
      error_handling("Termometro", 401); //Imprime código de estatus
    }
    intento++;
    delay(5000);
  }

  intento = 0; // Se reinicia el contador de intentos.

  /*BOOTUP LCD*/
  /* Se intenta iniciar el LCD 3 veces, si no se obtiene respuesta de u8g.begin(), se matiene el código de estatus 401
  y se continúa con el programa.*/
  while (intento < 3){
    if (u8g2.begin() != 0){
      u8g2.setColorIndex(1); // pixels on
      u8g2.enableUTF8Print();
      estatus[1] = 200;
      error_handling("LCD", 200); //Imprime código de estatus
      bootUp_screen();
      intento = 3;
      delay(5000);
      clear_screen();
    }
    else{
      estatus[1] = 501;
      //error_handling("LCD", 501); //Imprime código de estatus
    }
    intento++;
  }
delay(500);
}


void loop()
{
  float temperaturaAmbiente = termometroIR.readAmbientTempC();
  float temperaturaObjeto = termometroIR.readObjectTempC();
  /*LECTURA DE TEMPERATURA*/
  if (estatus[0] == 200){
    if (!(isnan(temperaturaAmbiente))){
      delay(5);
    }
    else{
      estatus[0] = 402; // El modificar el estatus, loop no volverá a ejecutar el código del termometro.
      error_handling("Termometro", 402); //Imprime código de estatus
    }
  }

  /*IMPRIMIR EN LCD*/
  if (estatus[1] == 200){
      u8g2.firstPage();  
    do {
      mostrar_display(temperaturaObjeto, temperaturaAmbiente);
    } while(u8g2.nextPage());
  }
  delay(100);
}

/*FUNCIONES*/

void bootUp_screen()
{
  // graphic commands to redraw the complete screen should be placed here
  // u8g.setFont(u8g_font_unifont);
  // u8g.setFont(u8g_font_helvB24);
  u8g2.setFont(u8g_font_profont17);
  u8g2.firstPage();
  do
  {
    u8g2.drawXBMP(0, 0, BORREGOS_SF_RACING_TEAM_W, BORREGOS_SF_RACING_TEAM_H, BORREGOS_SF_RACING_TEAM); // (x, y, width*8, height)
    u8g2.setFont(u8g2_font_helvB10_tf);
    u8g2.drawStr(46, 31, "JARVIS");
    u8g2.setFont(u8g2_font_6x13_tf);
    u8g2.drawStr(46, 45, "By SF RACING");
  } while (u8g2.nextPage());

  delay(6000);
} 

void clear_screen()
{
  u8g2.firstPage();
  do
  {
    u8g2.setColorIndex(0); // Clear pixel value
    u8g2.drawBox(0, 0, 64, 128); // Draw clear pixel in all LCD
  } while (u8g2.nextPage());
}

void mostrar_display(float temperaturaObjeto, float temperaturaAmbiente)
{
    u8g2.setFont(u8g2_font_helvB18_tf);
    u8g2.setColorIndex(1);
    u8g2.setCursor(7, 43);
    u8g2.print(temperaturaAmbiente, 1); //32 px
    u8g2.setCursor(71, 43);
    u8g2.print(temperaturaObjeto, 1); //32 px

    
    u8g2.setFont(u8g2_font_6x13_tf);
    u8g2.drawStr(20, 14, "#10 - SERGIO Z.");

    u8g2.drawStr(8, 60, "AMBNT");
    u8g2.drawUTF8(38, 60, DEGREE_SYMBOL);
    u8g2.drawStr(46, 60, "C"); //16 Px de ancho -- 8 pixeles mas que el simbolo °

    //u8g2.drawStr(10, 60, "KM/H"); //32 Px de ancho
    u8g2.drawStr(72, 60, "MOTOR");
    u8g2.drawUTF8(102, 60, DEGREE_SYMBOL);
    u8g2.drawStr(110, 60, "C"); //16 Px de ancho -- 8 pixeles mas que el simbolo °

}

// Función para imprimir los códigos de estatus.
void error_handling(String componente, int debug){
  Serial.print(componente + ": ");
  Serial.println(debug);
}
