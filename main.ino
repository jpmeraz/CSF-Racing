
// Libs Pantalla
#include "U8glib.h"

#include <Wire.h>
#include <Adafruit_MLX90614.h>

// Pins luz, ventilador, sonido
int luz_out = A3;
int vent_out = A2;
int s0und_out = 12;
//

U8GLIB_ST7920_128X64 u8g(13, 11, 10, U8G_PIN_NONE);
// Bitmaps
// Logotipo de la escudería
const unsigned char BORREGOS_SF_TEAM_RACING[] = {
    0xFF, 0xFF, 0xFF, 0xFF, 0xFF, 0xFF, 0xFF, 0xFF, 0xFF, 0xFF, 0xFF, 0xFF, 0xFF, 0xFF, 0xFF, 0xFF,
    0xE1, 0x00, 0x00, 0xFF, 0xFF, 0xFF, 0xFF, 0xFF, 0xFF, 0xFF, 0xFF, 0xFF, 0xFF, 0xFF, 0xFF, 0xFF,
    0xC1, 0x00, 0x00, 0x7C, 0x0F, 0x80, 0xE0, 0x78, 0x1F, 0x01, 0x80, 0xE0, 0x38, 0x1F, 0xFF, 0xFF,
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    0xFF, 0xFF, 0xFF, 0xFF, 0xFF, 0xFF, 0xFF, 0xFF, 0xFF, 0xFF, 0xFF, 0xFF, 0xFF, 0xFF, 0xFF, 0xFF};

// Símbolo de grados '°'
const unsigned char signogrados[] = {
    0x00,
    0x00,
    0x00,
    0x00,
};

// Libs Temperatura
#include <Wire.h>
#include <Adafruit_MLX90614.h>

// Instanciar objeto con nombre "termometroIR"
Adafruit_MLX90614 termometroIR = Adafruit_MLX90614();

// Variable
float temperaturaAmbiente = 0;
float temperaturaObjeto = 0;

// velocidad
int encoder_pin = 2;                        // Pin 2, donde se conecta el encoder
unsigned int rpm = 0;                       // Revoluciones por minuto calculadas del motor
unsigned int rpm_wheel = 0;                 // Revoluciones por minuto calculadas de la rueda
float velocity = 0;                         // Velocidad en [Km/h]
volatile byte pulses = 0;                   // Número de pulsos leidos por el Arduino en un segundo
unsigned long timeold = 0;                  // Tiempo
unsigned int pulsesperturn = 20;            // Número de muescas que tiene el disco del encoder.
const int wheel_diameter = 250;             // Diámetro de la rueda [mm]
int engrane_motor = 16;                     // Dientes del engrane que va al motor
int engrane_rueda = 38;                     // Dientes del engrane que va a la rueda
int mechanical_adv = 0;                     // Numero de vueltas que da la rueda comparada con el motor
static volatile unsigned long debounce = 0; // Tiempo del rebote.
//

void setup()
{

  // LCD

  // flip screen, if required
  u8g.setRot180();

  // Initialize mlx sensor
  //  set SPI backup if required
  // u8g.setHardwareBackup(u8g_backup_avr_spi);

  // assign default color value
  if (u8g.getMode() == U8G_MODE_R3G3B2)
  {
    u8g.setColorIndex(255); // white
  }
  else if (u8g.getMode() == U8G_MODE_GRAY2BIT)
  {
    u8g.setColorIndex(3); // max intensity
  }
  else if (u8g.getMode() == U8G_MODE_BW)
  {
    u8g.setColorIndex(1); // pixel on
  }
  else if (u8g.getMode() == U8G_MODE_HICOLOR)
  {
    u8g.setHiColorByRGB(255, 255, 255);
  }
  bootUp_screen();

  //clear_screen();

  // luz, ventilador, sonido
  pinMode(luz_out, OUTPUT);
  pinMode(vent_out, OUTPUT);
  pinMode(s0und_out, OUTPUT);

  digitalWrite(luz_out, HIGH);
  digitalWrite(vent_out, HIGH);
  //

  // tempeatura
  // Iniciar comunicación serie

  Serial.begin(9600); // opens serial port, sets data rate to 9600 bps

  Serial.println("Adafruit MXL90614 test");

  termometroIR.begin();
  
  // Iniciar termómetro infrarrojo con Arduino
  //termometroIR.begin();

}
//

void loop()
{

  // temperatura
  //  Obtener temperaturas grados Celsius
  //float temperaturaAmbiente = termometroIR.readAmbientTempC();
  //float temperaturaObjeto = termometroIR.readObjectTempC();

  

  // LCD
  //mostrar_display(temperaturaObjeto);

  float temperaturaAmbiente = termometroIR.readAmbientTempC();
  float temperaturaObjeto = termometroIR.readObjectTempC();

  Serial.print("Temp. ambiente => ");
  Serial.print(temperaturaAmbiente);
  Serial.println("ºC");

  Serial.print("Temp. objeto => ");
  Serial.print(temperaturaObjeto);
  Serial.println("ºC");


  u8g.firstPage();  
  do {
    mostrar_display(temperaturaObjeto);
  } while( u8g.nextPage() );

  delay(100);

}

// -----------------------------------------------IMPRIME LOGOTIPO DE LA ESCUDERÍA----------------------------------------------------------------------
void bootUp_screen()
{
  // graphic commands to redraw the complete screen should be placed here
  // u8g.setFont(u8g_font_unifont);
  // u8g.setFont(u8g_font_helvB24);
  u8g.setFont(u8g_font_profont17);
  u8g.firstPage();
  do
  {
    u8g.drawBitmap(0, 0, 16, 64, BORREGOS_SF_TEAM_RACING);
  } while (u8g.nextPage());

  delay(6000);
}

//-------------------------------------------------LIMPIA LA PANTALLA------------------------------------------------------------------------
void clear_screen()
{
  u8g.firstPage();
  do
  {
    u8g.setColorIndex(0);
    u8g.drawBox(0, 0, 64, 128);
  } while (u8g.nextPage());
}

//------------------------------------------------------MOSTRAR INFORMACIÓN EN LCD 128X64 CON COMUNICACIÓN SPI---------------------------------------------------------

void mostrar_display(int temperaturaObjeto)
{

    u8g.setFont(u8g_font_7x14B);
    u8g.setColorIndex(1);

    u8g.drawStr(74, 38, "TEMP:");
    u8g.setPrintPos(0, 38);
    u8g.print(temperaturaObjeto, 1);
    delay(100);
}